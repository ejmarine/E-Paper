## sdkconfig.defaults
```kconfig
CONFIG_IDF_TARGET="esp32s3"
CONFIG_ESPTOOLPY_FLASHSIZE_16MB=y
CONFIG_PARTITION_TABLE_CUSTOM=y
CONFIG_PARTITION_TABLE_CUSTOM_FILENAME="partitions.csv"

CONFIG_ESP_CONSOLE_USB_SERIAL_JTAG=y

# Smaller code, quieter boot.
CONFIG_COMPILER_OPTIMIZATION_SIZE=y
CONFIG_COMPILER_OPTIMIZATION_ASSERTIONS_SILENT=y
CONFIG_BOOTLOADER_COMPILER_OPTIMIZATION_SIZE=y
CONFIG_BOOTLOADER_LOG_LEVEL_NONE=y
CONFIG_NEWLIB_NANO_FORMAT=y
CONFIG_LOG_DEFAULT_LEVEL_WARN=y

# Font files stay on disk. None are compiled into the firmware.
# CONFIG_FONT12_EMBEDDED is not set
# CONFIG_FONT16_EMBEDDED is not set
# CONFIG_FONT18_EMBEDDED is not set
# CONFIG_FONT24_EMBEDDED is not set
# CONFIG_FONT28_EMBEDDED is not set
# CONFIG_FONT36_EMBEDDED is not set
# CONFIG_FONT48_EMBEDDED is not set
# CONFIG_Auxiliary_Font_EMBEDDED is not set
# CONFIG_FONT_ENABLE_TFCARD is not set
# CONFIG_FONT_ENABLE_SDCARD is not set
```
